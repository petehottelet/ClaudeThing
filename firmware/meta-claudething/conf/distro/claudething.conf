## firmware/meta-claudething/conf/layer.conf
```bitbake
BBPATH .= ":${LAYERDIR}"
BBFILES += "${LAYERDIR}/recipes-*/*/*.bb ${LAYERDIR}/recipes-*/*/*.bbappend"

BBFILE_COLLECTIONS += "claudething"
BBFILE_PATTERN_claudething := "^${LAYERDIR}/"
BBFILE_PRIORITY_claudething = "30"

LAYERVERSION_claudething = "1"
LAYERSERIES_COMPAT_claudething = "wrynose"
LAYERDEPENDS_claudething = "core superbird meson chromium-browser-layer"
```
